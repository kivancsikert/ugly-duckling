## sdkconfig.defaults
```kconfig
# Make sure to delete sdkconfig.* after making changes here
# so that they get regenerated!

# Won't compile without this
CONFIG_FREERTOS_HZ=1000

# Won't compile without this
CONFIG_ESP_TLS_PSK_VERIFICATION=y

# We don't need secure Boot
CONFIG_SECURE_BOOT=n
CONFIG_SECURE_FLASH_ENC_ENABLED=n

# We want to use exceptions
CONFIG_COMPILER_CXX_EXCEPTIONS=y

# Less chatty
CONFIG_BOOTLOADER_LOG_LEVEL_ERROR=y
CONFIG_LOG_DEFAULT_LEVEL_WARN=y
CONFIG_LOG_MAXIMUM_LEVEL_VERBOSE=y

# We do our own coloring in debug mode
CONFIG_LOG_COLORS=n

# Seems like a good idea to have some stack checks
CONFIG_COMPILER_STACK_CHECK_MODE_NORM=y

# This is ERROR by default
CONFIG_ARDUHAL_LOG_DEFAULT_LEVEL_WARN=y

# Why compile more than necessary?
CONFIG_ARDUINO_SELECTIVE_COMPILATION=y

# Give peripheral-related tasks to have some length to their names
CONFIG_FREERTOS_MAX_TASK_NAME_LEN=32

# Partition table config
CONFIG_PARTITION_TABLE_CUSTOM=y
CONFIG_PARTITION_TABLE_CUSTOM_FILENAME="partitions.csv"
CONFIG_PARTITION_TABLE_FILENAME="partitions.csv"

# Increase main task stack from default 3584
CONFIG_ESP_MAIN_TASK_STACK_SIZE=6144

# Allow time to be adjusted smoothly from the DHCP server's recommendation
CONFIG_LWIP_DHCP_GET_NTP_SRV=y
# Figure out how to enable smooth adjustment
# CONFIG_SNTP_SYNC_MODE_SMOOTH=y

#
# Power management
#

# Enable automatic light sleep
CONFIG_PM_ENABLE=y
CONFIG_FREERTOS_USE_TICKLESS_IDLE=y

# Use IRAM to let device sleep 310+20us more
CONFIG_PM_SLP_IRAM_OPT=y
CONFIG_PM_RTOS_IDLE_OPT=y

# Power down stuff
CONFIG_PM_SLP_DISABLE_GPIO=y
CONFIG_PM_POWER_DOWN_CPU_IN_LIGHT_SLEEP=y
CONFIG_PM_RESTORE_CACHE_TAGMEM_AFTER_LIGHT_SLEEP=y
# TODO Experiment with this
# CONFIG_PM_POWER_DOWN_PERIPHERAL_IN_LIGHT_SLEEP=y

# Recalibrate the RTC_FAST/SLOW clock less often
CONFIG_PM_LIGHTSLEEP_RTC_OSC_CAL_INTERVAL=16

# CONFIG_HEAP_TRACING_STANDALONE=y
# CONFIG_HEAP_TRACING_STACK_DEPTH=10
# CONFIG_HEAP_POISONING_LIGHT=y
# CONFIG_HEAP_TASK_TRACKING=y
```
